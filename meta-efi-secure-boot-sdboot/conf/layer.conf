## meta-efi-secure-boot-sdboot/conf/layer.conf
```bitbake
# We have a conf and classes directory, add to BBPATH
BBPATH .= ":${LAYERDIR}"

# We have recipes-* directories, add to BBFILES
BBFILES += "${LAYERDIR}/recipes-*/*/*.bb \
            ${LAYERDIR}/recipes-*/*/*.bbappend"

BBFILE_COLLECTIONS += "meta-efi-secure-boot-sdboot"
BBFILE_PATTERN_meta-efi-secure-boot-sdboot = "^${LAYERDIR}/"
BBFILE_PRIORITY_meta-efi-secure-boot-sdboot = "6"

LAYERDEPENDS_meta-efi-secure-boot-sdboot = " \
    core \
    intel \
"
LAYERSERIES_COMPAT_meta-efi-secure-boot-sdboot = "warrior zeus"

# define variables reqiured in uefi-sign.bbclass inside meta-intel
# used for Secure Boot signing
IMAGE_FEATURES[validitems] += "secureboot"
IMAGE_FEATURES += "secureboot"
SECURE_BOOT_SIGNING_KEY ?= "${UEFI_SB_KEYS_DIR}/DB.key"
SECURE_BOOT_SIGNING_CERT ?= "${UEFI_SB_KEYS_DIR}/DB.crt"
```
